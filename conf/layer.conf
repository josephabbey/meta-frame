## conf/machine/raspberrypi0-2w-64-frame-dev.conf
```bitbake
require conf/machine/raspberrypi0-2w-64-frame.conf

MACHINEOVERRIDES =. "raspberrypi0-2w-64-frame:"

ENABLE_UART = "1"
ENABLE_DWC2_PERIPHERAL = "1"
```

## conf/machine/raspberrypi0-2w-64-frame.conf
```bitbake
require conf/machine/raspberrypi0-2w-64.conf

MACHINEOVERRIDES =. "raspberrypi0-2w-64:"

ENABLE_I2C = "1"
ENABLE_SPI_BUS = "1"
CMDLINE:append = " modules-load=spidev,i2c-dev"
RPI_EXTRA_CONFIG:append = "\ndtoverlay=spi0-0cs\n\n"
RPI_KERNEL_DEVICETREE_OVERLAYS:append = " overlays/spi0-0cs.dtbo"

PREFERRED_RPROVIDER_libnss-mdns = "avahi-libnss-mdns"
PREFERRED_VERSION_python3 = "3.14.%"

LICENSE_FLAGS_ACCEPTED:append = " synaptics-killswitch"
```
